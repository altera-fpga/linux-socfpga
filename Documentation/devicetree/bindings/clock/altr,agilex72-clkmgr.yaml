## Documentation/devicetree/bindings/usb/altr,socfpga-dwc3.yaml
```yaml
# SPDX-License-Identifier: (GPL-2.0-only OR BSD-2-Clause)
%YAML 1.2
---
$id: http://devicetree.org/schemas/usb/altr,agilex5-dwc3.yaml#
$schema: http://devicetree.org/meta-schemas/core.yaml#

title: Altera Agilex5 DWC3 USB SoC Controller

maintainers:
  - Adrian Ng Ho Yin <adrian.ho.yin.ng@altera.com>

description:
  The Altera Agilex5 SoCFPGA integrates a Synopsys DesignWare USB3 (DWC3)
  controller that supports host, device and DRD modes.

allOf:
  - $ref: snps,dwc3-common.yaml#

properties:
  compatible:
    const: altr,agilex5-dwc3

  reg:
    description: Agilex5 USB31 wrapper register block.
    maxItems: 1

  clocks:
    items:
      - description: Controller reference clock
      - description: Controller suspend clock
      - description: Master/Core bus clock

  clock-names:
    items:
      - const: ref
      - const: suspend
      - const: bus_early

  interrupts:
    maxItems: 1

  phys:
    minItems: 2
    maxItems: 2

  phy-names:
    items:
      - const: usb2-phy
      - const: usb3-phy

  iommus:
    maxItems: 1

  resets:
    description: Resets for the DWC3 core and its ECC block.
    items:
      - description: DWC3 core reset
      - description: DWC3 ECC reset

  reset-names:
    items:
      - const: dwc3
      - const: dwc3-ecc

required:
  - compatible
  - reg
  - clocks
  - clock-names
  - interrupts
  - phys
  - phy-names
  - resets
  - reset-names

unevaluatedProperties: false

examples:
  - |
    #include <dt-bindings/interrupt-controller/arm-gic.h>
    #include <dt-bindings/reset/altr,rst-mgr-s10.h>
    #include <dt-bindings/clock/intel,agilex5-clkmgr.h>

    soc {
        #address-cells = <1>;
        #size-cells = <1>;

        usb@11000000 {
            compatible = "altr,agilex5-dwc3";
            reg = <0x11000000 0x100000>;
            interrupts = <GIC_SPI 94 IRQ_TYPE_LEVEL_HIGH>;
            clocks = <&clkmgr AGILEX5_USB31_REF_CLK>,
                     <&clkmgr AGILEX5_USB31_SUSPEND_CLK>,
                     <&clkmgr AGILEX5_USB31_BUS_CLK_EARLY>;
            clock-names = "ref", "suspend", "bus_early";
            phys = <&usbphy0>, <&usbphy1>;
            phy-names = "usb2-phy", "usb3-phy";
            resets = <&rst USB1_RESET>, <&rst USB1_OCP_RESET>;
            reset-names = "dwc3", "dwc3-ecc";
            iommus = <&smmu 7>;
        };
    };
```

## drivers/net/ethernet/altera/Kconfig
```kconfig
# SPDX-License-Identifier: GPL-2.0-only
# Altera device configuration
# Copyright (C) 2014,2026 Altera Corporation. All rights reserved

config NET_ALTERA_ETH
	bool "Altera Ethernet drivers"
	help
	  Say Y here to enable support for Altera/Intel FPGA Ethernet drivers.
	  This includes the Triple-Speed Ethernet MAC and HSSI Subsystem
	  drivers for use with Altera FPGAs.

	  If unsure, say N.

if NET_ALTERA_ETH

config ALTERA_TSE
	tristate "Altera Triple-Speed Ethernet MAC support"
	depends on HAS_DMA
	depends on HAS_IOMEM
	select PHYLIB
	select PHYLINK
	select PCS_LYNX
	select MDIO_REGMAP
	select REGMAP_MMIO
	help
	  This driver supports the Altera Triple-Speed (TSE) Ethernet MAC.

	  To compile this driver as a module, choose M here. The module
	  will be called alteratse.

config ALTERA_HSSISS
	tristate "Altera FPGA HSSI Subsystem support"
	depends on HAS_IOMEM
	depends on OF
	help
	  This driver supports the Altera FPGA HSSI subsystem.

	  To compile this driver as a module, choose M here. The module
	  will be called altera-hssiss.

endif
```
