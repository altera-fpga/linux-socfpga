## Documentation/devicetree/bindings/clock/altr,agilex72-clkmgr.yaml
```yaml
# SPDX-License-Identifier: (GPL-2.0-only OR BSD-2-Clause)
%YAML 1.2
---
$id: http://devicetree.org/schemas/clock/altr,agilex72-clkmgr.yaml#
$schema: http://devicetree.org/meta-schemas/core.yaml#

title: Altera SoCFPGA Agilex72 clock manager

maintainers:
  - Chiam, Evon <evon.chiam@altera.com>

description:
  The Altera Agilex72 Clock Manager is an integrated clock controller, which
  generates and supplies clock to all the modules.

properties:
  compatible:
    const: altr,agilex72-clkmgr

  reg:
    items:
      - description: Clock manager registers
      - description: GPPLL0 registers
      - description: GPPLL1 registers
      - description: GPPLL2 registers

  reg-names:
    items:
      - const: clkmgr
      - const: gppll0
      - const: gppll1
      - const: gppll2

  '#clock-cells':
    const: 1

required:
  - compatible
  - reg
  - reg-names
  - '#clock-cells'

additionalProperties: false

examples:
  - |
    /* External reference clocks supplied to the clock manager */
    clocks {
      compatible = "simple-bus";
      #address-cells = <1>;
      #size-cells = <0>;

      cb_intosc_div2_clk: cb-intosc-div2-clk@0 {
        reg = <0>;
        #clock-cells = <0>;
        compatible = "fixed-clock";
        clock-frequency = <0>;
      };

      /* cb-intosc divided by 2, then by 5 (total divide-by-10) */
      cb_intosc_div10_clk: cb-intosc-div10-clk@1 {
        reg = <1>;
        #clock-cells = <0>;
        compatible = "fixed-factor-clock";
        clocks = <&cb_intosc_div2_clk>;
        clock-mult = <1>;
        clock-div = <5>;
      };

      f2s_free_clk: f2s-free-clk@2 {
        reg = <2>;
        #clock-cells = <0>;
        compatible = "fixed-clock";
        clock-frequency = <0>;
      };

      osc1: osc1@3 {
        reg = <3>;
        #clock-cells = <0>;
        compatible = "fixed-clock";
        clock-frequency = <0>;
      };
    };

    clkmgr: clock-controller@915c000 {
      compatible = "altr,agilex72-clkmgr";
      reg = <0x915c000 0x1000>,
            <0x915e000 0x1000>,
            <0x915f000 0x1000>,
            <0x9160000 0x1000>;
      reg-names = "clkmgr", "gppll0", "gppll1", "gppll2";
      #clock-cells = <1>;
    };
...
```

## Documentation/devicetree/bindings/dma/altr,socfpga-pref-msgdma.yaml
```yaml
# SPDX-License-Identifier: (GPL-2.0-only OR BSD-2-Clause)
%YAML 1.2
---
$id: http://devicetree.org/schemas/dma/altr,socfpga-pref-msgdma.yaml#
$schema: http://devicetree.org/meta-schemas/core.yaml#

title: Altera SoCFPGA mSGDMA Prefetcher Controller

maintainers:
  - Preetam Narayan <preetam.narayan@altera.com>

description: |
  Altera SoCFPGA mSGDMA Prefetcher Controller for high-performance
  DMA transfers on SoCFPGA platforms.

properties:
  compatible:
    const: altr,socfpga-pref-msgdma

  reg:
    items:
      - description: Prefetcher CSR register region (pref_csr).
      - description: DMA CSR register region (dma_csr).
      - description: FIFO info register region (fifo_info).

  reg-names:
    items:
      - const: pref_csr
      - const: dma_csr
      - const: fifo_info

  interrupts:
    maxItems: 1
    description: The interrupt for the DMA controller.

  interrupt-names:
    items:
      - const: dma-irq
    description: Name for the interrupt.

  '#dma-cells':
    const: 1
    description: Number of cells to encode DMA specifier.

  fifo-depth:
    $ref: /schemas/types.yaml#/definitions/uint32
    description: Depth of the FIFO buffer in the DMA engine. Must be greater than
      fifo-almost-full, which must be greater than fifo-almost-empty.

  fifo-almost-full:
    $ref: /schemas/types.yaml#/definitions/uint32
    description: FIFO threshold for 'almost full' condition. Must be less than
      fifo-depth and greater than fifo-almost-empty.

  fifo-almost-empty:
    $ref: /schemas/types.yaml#/definitions/uint32
    description: FIFO threshold for 'almost empty' condition. Must be less than
      fifo-almost-full.

  prefetch-capability:
    $ref: /schemas/types.yaml#/definitions/uint32
    maximum: 512
    default: 16
    description: Maximum number of descriptors that can be prefetched.
      Defaults to 16 if not specified.

  poll-freq:
    $ref: /schemas/types.yaml#/definitions/uint32
    minimum: 128
    default: 128
    description: Polling frequency used by the DMA channel. Defaults to 128 if not specified.

  channel-name:
    $ref: /schemas/types.yaml#/definitions/string
    description: Optional name assigned to the DMA channel.

required:
  - compatible
  - reg
  - reg-names
  - interrupts
  - interrupt-names
  - '#dma-cells'
  - fifo-depth
  - fifo-almost-full
  - fifo-almost-empty

additionalProperties: false

examples:
  - |
    #include <dt-bindings/interrupt-controller/arm-gic.h>
    dma0_tx: dma@45000000 {
      compatible = "altr,socfpga-pref-msgdma";
      reg-names = "pref_csr", "dma_csr", "fifo_info";
      reg = <0x45000000 0x20>, <0x45000020 0x20>, <0x45000040 0x20>;
      #dma-cells = <1>;
      interrupt-parent = <&intc>;
      interrupts = <GIC_SPI 17 IRQ_TYPE_LEVEL_HIGH>;
      interrupt-names = "dma-irq";
      fifo-depth = <0x1000>;
      fifo-almost-full = <0x800>;
      fifo-almost-empty = <0x400>;
      prefetch-capability = <16>;
    };
```

## Documentation/devicetree/bindings/mmc/cdns,sdhci.yaml
```yaml
# SPDX-License-Identifier: GPL-2.0-only OR BSD-2-Clause
%YAML 1.2
---
$id: http://devicetree.org/schemas/mmc/cdns,sdhci.yaml#
$schema: http://devicetree.org/meta-schemas/core.yaml#

title: Cadence SD/SDIO/eMMC Host Controller (SD4HC/SD6HC)

maintainers:
  - Masahiro Yamada <yamada.masahiro@socionext.com>

properties:
  compatible:
    oneOf:
      - description: Cadence SD4HC controller
        items:
          - enum:
              - amd,pensando-elba-sd4hc
              - intel,agilex5-sd4hc
              - microchip,mpfs-sd4hc
              - microchip,pic64gx-sd4hc
              - mobileye,eyeq-sd4hc
              - socionext,uniphier-sd4hc
          - const: cdns,sd4hc
      - description: Cadence SD6HC controller
        oneOf:
          - items:
              - const: altr,agilex5-sd6hc
              - const: cdns,sd6hc
          - const: cdns,sd6hc

  reg:
    minItems: 1
    maxItems: 2

  interrupts:
    maxItems: 1

  clocks:
    minItems: 1
    maxItems: 2

  clock-names:
    minItems: 1
    maxItems: 2

  resets:
    minItems: 1
    maxItems: 3

  reset-names:
    minItems: 1
    maxItems: 3

  iommus:
    maxItems: 1

  dma-coherent: true

  # PHY DLL input delays:
  # They are used to delay the data valid window, and align the window to
  # sampling clock. The delay starts from 5ns (for delay parameter equal to 0)
  # and it is increased by 2.5ns in each step.

  cdns,phy-input-delay-sd-highspeed:
    description: Value of the delay in the input path for SD high-speed timing
    $ref: /schemas/types.yaml#/definitions/uint32
    minimum: 0
    maximum: 0x1f

  cdns,phy-input-delay-legacy:
    description: Value of the delay in the input path for legacy timing
    $ref: /schemas/types.yaml#/definitions/uint32
    minimum: 0
    maximum: 0x1f

  cdns,phy-input-delay-sd-uhs-sdr12:
    description: Value of the delay in the input path for SD UHS SDR12 timing
    $ref: /schemas/types.yaml#/definitions/uint32
    minimum: 0
    maximum: 0x1f

  cdns,phy-input-delay-sd-uhs-sdr25:
    description: Value of the delay in the input path for SD UHS SDR25 timing
    $ref: /schemas/types.yaml#/definitions/uint32
    minimum: 0
    maximum: 0x1f

  cdns,phy-input-delay-sd-uhs-sdr50:
    description: Value of the delay in the input path for SD UHS SDR50 timing
    $ref: /schemas/types.yaml#/definitions/uint32
    minimum: 0
    maximum: 0x1f

  cdns,phy-input-delay-sd-uhs-ddr50:
    description: Value of the delay in the input path for SD UHS DDR50 timing
    $ref: /schemas/types.yaml#/definitions/uint32
    minimum: 0
    maximum: 0x1f

  cdns,phy-input-delay-mmc-highspeed:
    description: Value of the delay in the input path for MMC high-speed timing
    $ref: /schemas/types.yaml#/definitions/uint32
    minimum: 0
    maximum: 0x1f

  cdns,phy-input-delay-mmc-ddr:
    description: Value of the delay in the input path for eMMC high-speed DDR timing

  # PHY DLL clock delays:
  # Each delay property represents the fraction of the clock period.
  # The approximate delay value will be
  # (<delay property value>/128)*sdmclk_clock_period.
    $ref: /schemas/types.yaml#/definitions/uint32
    minimum: 0
    maximum: 0x1f

  cdns,phy-dll-delay-sdclk:
    description: |
      Value of the delay introduced on the sdclk output for all modes except
      HS200, HS400 and HS400_ES.
    $ref: /schemas/types.yaml#/definitions/uint32
    minimum: 0
    maximum: 0x7f

  cdns,phy-dll-delay-sdclk-hsmmc:
    description: |
      Value of the delay introduced on the sdclk output for HS200, HS400 and
      HS400_ES speed modes.
    $ref: /schemas/types.yaml#/definitions/uint32
    minimum: 0
    maximum: 0x7f

  cdns,phy-dll-delay-strobe:
    description: |
      Value of the delay introduced on the dat_strobe input used in
      HS400 / HS400_ES speed modes.
    $ref: /schemas/types.yaml#/definitions/uint32
    minimum: 0
    maximum: 0x7f

  # SD6HC PHY timing properties:
  cdns,iocell-input-delay:
    description: Input delay across IO cells in picoseconds
    $ref: /schemas/types.yaml#/definitions/uint32
    minimum: 0
    maximum: 20000   # 20 ns

  cdns,iocell-output-delay:
    description: Output delay across IO cells in picoseconds
    $ref: /schemas/types.yaml#/definitions/uint32
    minimum: 0
    maximum: 20000   # 20 ns

  cdns,delay-element:
    description: Delay element size in picoseconds
    $ref: /schemas/types.yaml#/definitions/uint32
    minimum: 1
    maximum: 1000

  cdns,ddr50-read-dqs-delay:
    description: |
      SD6HC DDR50 read-DQS delay (DLL_SLAVE[7:0]) used to centre the read
      eye. DDR50 has no CMD19 tuning, so this is a board/SoC-characterised
      value. If absent, the driver default is used.
    $ref: /schemas/types.yaml#/definitions/uint32
    minimum: 0
    maximum: 0xff

  cdns,ddr50-use-lpbk-dqs:
    description: |
      SD6HC DDR50 read-DQS source (DQS_TIMING[21]): 0 = phony DQS,
      1 = loopback DQS. If absent, the driver default is used.
    $ref: /schemas/types.yaml#/definitions/uint32
    enum: [0, 1]

  cdns,ddr50-phony-dqs-timing:
    description: |
      SD6HC DDR50 phony DQS assertion timing (PHY_CTRL[9:4]). Positions the
      fabricated read strobe relative to the returning DDR data; the correct
      value depends on the board's SD flight time and is not produced by the
      Cadence timing calculation. If absent, the driver default
      (REBAR_PULSE_CYCLES-1) is used.
    $ref: /schemas/types.yaml#/definitions/uint32
    minimum: 0
    maximum: 0x3f

required:
  - compatible
  - reg
  - interrupts
  - clocks

allOf:
  - $ref: sdhci-common.yaml
  - if:
      properties:
        compatible:
          contains:
            const: amd,pensando-elba-sd4hc
    then:
      properties:
        reg:
          items:
            - description: Host controller registers
            - description: Elba byte-lane enable register for writes
      required:
        - resets
    else:
      properties:
        reg:
          maxItems: 1

  - if:
      properties:
        compatible:
          contains:
            const: cdns,sd6hc
    then:
      description: SD6HC variant - use IO-cell and delay element properties
      properties:
        clocks:
          minItems: 2
          maxItems: 2
        clock-names:
          items:
            - const: ciu
            - const: biu
        cdns,phy-input-delay-sd-highspeed: false
        cdns,phy-input-delay-legacy: false
        cdns,phy-input-delay-sd-uhs-sdr12: false
        cdns,phy-input-delay-sd-uhs-sdr25: false
        cdns,phy-input-delay-sd-uhs-sdr50: false
        cdns,phy-input-delay-sd-uhs-ddr50: false
        cdns,phy-input-delay-mmc-highspeed: false
        cdns,phy-input-delay-mmc-ddr: false
        cdns,phy-dll-delay-sdclk: false
        cdns,phy-dll-delay-sdclk-hsmmc: false
        cdns,phy-dll-delay-strobe: false
      required:
        - clock-names

  - if:
      properties:
        compatible:
          contains:
            const: altr,agilex5-sd6hc
    then:
      properties:
        resets:
          minItems: 1
          maxItems: 3
        reset-names:
          oneOf:
            - items:
                - const: sdhc-reset
                - const: combophy
                - const: sdmmc-ocp
            - items:
                - const: sdhc-reset
      required:
        - resets

  - if:
      properties:
        compatible:
          contains:
            const: cdns,sd4hc
    then:
      description: SD4HC variant - use legacy DLL delay properties
      properties:
        resets:
          maxItems: 1
        cdns,iocell-input-delay: false
        cdns,iocell-output-delay: false
        cdns,delay-element: false
        cdns,ddr50-read-dqs-delay: false
        cdns,ddr50-use-lpbk-dqs: false
        cdns,ddr50-phony-dqs-timing: false

unevaluatedProperties: false

examples:
  - |
    emmc: mmc@5a000000 {
        compatible = "socionext,uniphier-sd4hc", "cdns,sd4hc";
        reg = <0x5a000000 0x400>;
        interrupts = <0 78 4>;
        clocks = <&clk 4>;
        bus-width = <8>;
        mmc-ddr-1_8v;
        mmc-hs200-1_8v;
        mmc-hs400-1_8v;
        cdns,phy-dll-delay-sdclk = <0>;
    };
```

## Documentation/devicetree/bindings/net/altr,hssiss.yaml
```yaml
# SPDX-License-Identifier: (GPL-2.0-only OR BSD-2-Clause)
%YAML 1.2
---
$id: http://devicetree.org/schemas/net/altr,hssiss.yaml#
$schema: http://devicetree.org/meta-schemas/core.yaml#

title: Altera HSSI subsystem for ethernet

maintainers:
  - Subhransu S. Prusty <subhransu.sekhar.prusty@altera.com>
  - Preetam Narayan <preetam.narayan@altera.com>

description: |
  Altera HSSI SS(subsystem) IP provides connectivity to core ethernet IPs (soft IP
  and hard IP). HSSI subsystem runs a firmware enabling netdev users standardized
  access to core ethernet subsystem. HSSI SS manages the configuration of
  ethernet IPs, while facilitating the data transfer between DMA and core
  through AXI interface.

properties:
  compatible:
    const: altr,hssiss-1.0

  reg:
    description: Address and length of configuration space
    maxItems: 1

  reg-names:
    items:
      - const: sscsr

  reset-mode:
    description: Interface medium to reset the HSSI SS and ethernet core
    enum:
      - reg
      - gpio

  cold-reset:
    type: object
    description: Register used to perform a cold reset of the HSSI SS
    properties:
      ofs:
        description: Offset of the cold-reset register from the HSSI SS CSR base
        $ref: /schemas/types.yaml#/definitions/uint32

      rst-bit:
        description: Bit used to assert the cold reset
        $ref: /schemas/types.yaml#/definitions/uint32

      rst-ack:
        description: Bit indicating cold-reset completion
        $ref: /schemas/types.yaml#/definitions/uint32

    required:
      - ofs
      - rst-bit
      - rst-ack

    additionalProperties: false

required:
  - compatible
  - reg
  - reg-names

additionalProperties: false

examples:
  - |
    hssiss_0_hssiss: hssiss@80000000 {
      compatible = "altr,hssiss-1.0";
      reg-names = "sscsr";
      reg = <0x80000000 0x04000000>;
      reset-mode ="reg";
      cold-reset {
        ofs = <0x100>;
        rst-bit = <0>;
        rst-ack = <1>;
      };
    };
```
